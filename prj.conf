## CMakeLists.txt
```
include($ENV{ZEPHYR_BASE}/cmake/app/boilerplate.cmake NO_POLICY_SCOPE)
project(NONE)

target_sources(app PRIVATE
	       src/main.c
	       src/on_chip_temp.c
	       src/bt_gatt_read.c
	       src/battery_voltage.c
	       src/tcs34725.c
	       src/hts221_bt.c
	       src/ccs811_bt.c
	       src/tcs34725_bt.c
	       src/vdd.c
	       src/meas_rates.c
)
```

## prj.conf
```kconfig
CONFIG_STDOUT_CONSOLE=y

CONFIG_BT=y
CONFIG_BT_SMP=y
CONFIG_BT_PERIPHERAL=y
CONFIG_BT_DEBUG_LOG=y
CONFIG_BT_DEVICE_NAME="IAQ Sensor"
CONFIG_BT_DEVICE_APPEARANCE=768

CONFIG_I2C=y
CONFIG_SYS_LOG_I2C_LEVEL=2
CONFIG_I2C_NRF5=y
CONFIG_I2C_0=y

CONFIG_I2C_1=y

CONFIG_SENSOR=y
CONFIG_SYS_LOG_SENSOR_LEVEL=1

CONFIG_GPIO_SX1509B=y
CONFIG_GPIO_SX1509B_INIT_PRIORITY=70

CONFIG_HTS221=y
CONFIG_HTS221_TRIGGER=y
CONFIG_HTS221_GPIO_DEV_NAME="GPIO_0"
CONFIG_HTS221_GPIO_PIN_NUM=24
CONFIG_HTS221_ODR="1"

CONFIG_CCS811=y
CONFIG_CCS811_GPIO_DEV_NAME="GPIO_P0"
CONFIG_CCS811_GPIO_WAKEUP=y
CONFIG_CCS811_GPIO_WAKEUP_PIN_NUM=12
```

## src/main.c
```c
#include <stdio.h>

#include <bluetooth/bluetooth.h>
#include <bluetooth/conn.h>
#include <bluetooth/gatt.h>
#include <sensor.h>
#include <gpio.h>
#include <nrf.h>
#include <soc_power.h>
#include <board.h>

#include "tcs34725.h"
#include "on_chip_temp.h"
#include "battery_voltage.h"
#include "hts221_bt.h"
#include "ccs811_bt.h"
#include "tcs34725_bt.h"
#include "bt_gatt_read.h"
#include "meas_rates.h"

#define SYS_LOG_DOMAIN "main"
#define SYS_LOG_LEVEL SYS_LOG_LEVEL_INFO
#include <logging/sys_log.h>

#define DEVICE_NAME	CONFIG_BT_DEVICE_NAME
#define DEVICE_NAME_LEN	(sizeof(CONFIG_BT_DEVICE_NAME) - 1)

#define BT_SENSOR_THREAD_STACK_SIZE 256

static const struct bt_data bt_ad[] = {
	BT_DATA_BYTES(BT_DATA_FLAGS, (BT_LE_AD_GENERAL | BT_LE_AD_NO_BREDR)),
	BT_DATA_BYTES(BT_DATA_UUID16_ALL, 0x0d, 0x18, 0x0f, 0x18, 0x05, 0x18),
};

static const struct bt_data bt_sd[] = {
	BT_DATA(BT_DATA_NAME_COMPLETE, DEVICE_NAME, DEVICE_NAME_LEN),
};

static struct bt_gatt_attr bt_ess_attrs[] = {
	BT_GATT_PRIMARY_SERVICE(BT_UUID_ESS),

	/* Battery voltage */
	BT_GATT_CHARACTERISTIC(BT_UUID_BAS_BATTERY_LEVEL,
			       BT_GATT_CHRC_READ | BT_GATT_CHRC_NOTIFY),
	BT_GATT_DESCRIPTOR(BT_UUID_BAS_BATTERY_LEVEL, BT_GATT_PERM_READ,
			   read_u16, NULL, &battery_voltage),
	BT_GATT_CUD("Battery Voltage", BT_GATT_PERM_READ),

	/* HTS221 */
	BT_GATT_CHARACTERISTIC(BT_UUID_TEMPERATURE,
			       BT_GATT_CHRC_READ | BT_GATT_CHRC_NOTIFY),
	BT_GATT_DESCRIPTOR(BT_UUID_TEMPERATURE, BT_GATT_PERM_READ, read_u16,
			   NULL, &hts221_bt_temp),
	BT_GATT_CUD("Temperature", BT_GATT_PERM_READ),

	BT_GATT_CHARACTERISTIC(BT_UUID_HUMIDITY,
			       BT_GATT_CHRC_READ | BT_GATT_CHRC_NOTIFY),
	BT_GATT_DESCRIPTOR(BT_UUID_HUMIDITY, BT_GATT_PERM_READ, read_u16,
			   NULL, &hts221_bt_humid),
	BT_GATT_CUD("Humidity", BT_GATT_PERM_READ),

	/* CCS811 */
	BT_GATT_CHARACTERISTIC(UUID_CO2,
			       BT_GATT_CHRC_READ | BT_GATT_CHRC_NOTIFY),
	BT_GATT_DESCRIPTOR(UUID_CO2, BT_GATT_PERM_READ, read_u16,
			   NULL, &ccs811_bt_co2),
	BT_GATT_CUD("CO2", BT_GATT_PERM_READ),

	BT_GATT_CHARACTERISTIC(UUID_VOC,
			       BT_GATT_CHRC_READ | BT_GATT_CHRC_NOTIFY),
	BT_GATT_DESCRIPTOR(UUID_VOC, BT_GATT_PERM_READ, read_u16,
			   NULL, &ccs811_bt_voc),
	BT_GATT_CUD("VOC", BT_GATT_PERM_READ),

	/* TCS34725 */
	BT_GATT_CHARACTERISTIC(UUID_RED,
			       BT_GATT_CHRC_READ | BT_GATT_CHRC_NOTIFY),
	BT_GATT_DESCRIPTOR(UUID_RED, BT_GATT_PERM_READ, read_u16,
			   NULL, &tcs34725_bt_r),
	BT_GATT_CUD("Red", BT_GATT_PERM_READ),

	BT_GATT_CHARACTERISTIC(UUID_GREEN,
			       BT_GATT_CHRC_READ | BT_GATT_CHRC_NOTIFY),
	BT_GATT_DESCRIPTOR(UUID_GREEN, BT_GATT_PERM_READ, read_u16,
			   NULL, &tcs34725_bt_g),
	BT_GATT_CUD("Green", BT_GATT_PERM_READ),

	BT_GATT_CHARACTERISTIC(UUID_BLUE,
			       BT_GATT_CHRC_READ | BT_GATT_CHRC_NOTIFY),
	BT_GATT_DESCRIPTOR(UUID_BLUE, BT_GATT_PERM_READ, read_u16,
			   NULL, &tcs34725_bt_b),
	BT_GATT_CUD("Blue", BT_GATT_PERM_READ),

	BT_GATT_CHARACTERISTIC(UUID_LIGHT,
			       BT_GATT_CHRC_READ | BT_GATT_CHRC_NOTIFY),
	BT_GATT_DESCRIPTOR(UUID_LIGHT, BT_GATT_PERM_READ, read_u16,
			   NULL, &tcs34725_bt_l),
	BT_GATT_CUD("Light", BT_GATT_PERM_READ),
};

static struct bt_gatt_service bt_ess_svc = BT_GATT_SERVICE(bt_ess_attrs);

static void bt_ready_cb(int err)
{
	if (err) {
		SYS_LOG_ERR("Bluetooth init failed: %d", err);
		return;
	}

	err = bt_gatt_service_register(&bt_ess_svc);

	if (err) {
		SYS_LOG_ERR("Could not register GATT service: %d", err);
		return;
	}

	err = bt_le_adv_start(BT_LE_ADV_CONN, bt_ad, ARRAY_SIZE(bt_ad),
			      bt_sd, ARRAY_SIZE(bt_sd));
	if (err) {
		SYS_LOG_ERR("Bluetooth advertising start failed: %d", err);
		return;
	}
}

static void bt_connected_cb(struct bt_conn *conn, u8_t err)
{
	if (err) {
		SYS_LOG_ERR("Bluetooth connect failed: %d", err);
		return;
	}
	SYS_LOG_DBG("Bluetooth connected\n");
}

static void bt_disconnected_cb(struct bt_conn *conn, u8_t reason)
{
	SYS_LOG_DBG("Bluetooth disconnected: %d", reason);
}

static struct bt_conn_cb bt_conn_callbacks = {
	.connected = bt_connected_cb,
	.disconnected = bt_disconnected_cb,
};

#ifdef CONFIG_BOARD_NRF52_PCA20020
static void gpio_test(void)
{
	struct device *gpio;
	gpio = device_get_binding(CONFIG_GPIO_SX1509B_DEV_NAME);
	if (!gpio) {
		SYS_LOG_ERR("Failed to get SX1509B device binding: %s",
			    CONFIG_GPIO_SX1509B_DEV_NAME);
		return;
	}

	for (int i = 5; i < 8; ++i) {
		gpio_pin_configure(gpio, i, GPIO_DIR_OUT | GPIO_PUD_PULL_UP);
		gpio_pin_write(gpio, i, 0);
		k_sleep(500);
	}

	k_sleep(500);

	for (int i = 5; i < 8; ++i)
		gpio_pin_write(gpio, i, 1);
}
#else
static void gpio_test(void)
{
}
#endif

void set_meas_intervals(void)
{
	struct device *gpio = device_get_binding(SW0_GPIO_NAME);
	int button;

	gpio_pin_configure(gpio, SW0_GPIO_PIN, GPIO_DIR_IN | GPIO_PUD_PULL_UP);
	gpio_pin_write(gpio, SW0_GPIO_PIN, 1);
	gpio_pin_read(gpio, SW0_GPIO_PIN, &button);
	printf("Button: %d\n", button);
	gpio_pin_write(gpio, SW0_GPIO_PIN, 0);
	gpio_pin_configure(gpio, SW0_GPIO_PIN, GPIO_DIR_IN);
	meas_intervals = button ? &fast_meas_intervals : &slow_meas_intervals;
}

void main(void)
{
	int err;

	err = bt_enable(bt_ready_cb);
	if (err)
		SYS_LOG_ERR("Bluetooth enable failed: %d", err);

	bt_conn_cb_register(&bt_conn_callbacks);

	set_meas_intervals();

	gpio_test();

	_sys_soc_set_power_state(SYS_POWER_STATE_CPU_LPS_1);

	for (;;) {
		k_sleep(5000);
	}
}
```

## src/battery_voltage.c
```c
#include <nrf.h>
#include <stdio.h>
#include <kernel.h>

#include "battery_voltage.h"

#define SYS_LOG_DOMAIN "battery"
#define SYS_LOG_LEVEL SYS_LOG_LEVEL_INFO
#include <logging/sys_log.h>

void battery_voltage_init(void)
{
	battery_voltage_update();
}

u16_t battery_voltage_get(void)
{
	u32_t bat_adc;

	NRF_SAADC->ENABLE = 1;

	/* RESP VDD/2, RESN GND, GAIN: 1/4 */
	NRF_SAADC->CH[0].CONFIG = (3<<0) | (1<<4) | (2<<8);
	NRF_SAADC->CH[0].PSELP = 0;
	NRF_SAADC->CH[0].PSELN = 0;

	NRF_SAADC->RESULT.PTR = (uint32_t)&bat_adc;
	NRF_SAADC->RESULT.MAXCNT = 1;
	NRF_SAADC->RESOLUTION = 3;

	NRF_SAADC->TASKS_START = 1;
	while (!(NRF_SAADC->EVENTS_STARTED))
		;
	NRF_SAADC->TASKS_SAMPLE = 1;
	while (!(NRF_SAADC->EVENTS_END))
		;
	NRF_SAADC->TASKS_STOP = 1;

	/* 14-bit conversion, 1/4 gain, 1/2 VCC at RESP, 0.6V ref */
	return (6 * 100 * bat_adc)>>(14 - 3);
}

void battery_voltage_update(void)
{
	battery_voltage = battery_voltage_get();
}

static void battery_voltage_thread(void *p1, void *p2, void *p3)
{
	for (;;) {
		battery_voltage_update();
		k_sleep(BATTERY_VOLTAGE_MEAS_INTERVAL);
	}
}

K_THREAD_DEFINE(battery_voltage_thd, 512, battery_voltage_thread, NULL, NULL, NULL,
		10, 0, K_NO_WAIT);
```

## src/battery_voltage.h
```c
#ifndef BATTERY_VOLTAGE_H
#define BATTERY_VOLTAGE_H

#include <zephyr/types.h>

#define BATTERY_VOLTAGE_MEAS_INTERVAL 1000

u16_t battery_voltage_get(void);
void battery_voltage_init(void);
void battery_voltage_update(void);
u16_t battery_voltage;

#endif
```

## src/bt_gatt_read.c
```c
#include <bluetooth/gatt.h>
#include <misc/byteorder.h>

#include "bt_gatt_read.h"

ssize_t read_u16(struct bt_conn *conn, const struct bt_gatt_attr *attr,
		 void *buf, u16_t len, u16_t offset)
{
        const u16_t *u16 = attr->user_data;
        u16_t value = sys_cpu_to_le16(*u16);

        return bt_gatt_attr_read(conn, attr, buf, len, offset, &value,
                                 sizeof(value));
}

ssize_t read_u32(struct bt_conn *conn, const struct bt_gatt_attr *attr,
		 void *buf, u16_t len, u16_t offset)
{
        const u32_t *u32 = attr->user_data;
        u32_t value = sys_cpu_to_le16(*u32);

        return bt_gatt_attr_read(conn, attr, buf, len, offset, &value,
                                 sizeof(value));
}
```

## src/bt_gatt_read.h
```c
#ifndef BT_GATT_READ_H
#define BT_GATT_READ_H

#include <zephyr/types.h>

ssize_t read_u16(struct bt_conn *conn, const struct bt_gatt_attr *attr,
		 void *buf, u16_t len, u16_t offset);

ssize_t read_u32(struct bt_conn *conn, const struct bt_gatt_attr *attr,
		 void *buf, u16_t len, u16_t offset);

#endif
```

## src/ccs811_bt.c
```c
#include <bluetooth/gatt.h>
#include <nrf.h>
#include <sensor.h>
#include <stdio.h>
#include <gpio.h>

#include "ccs811_bt.h"
#include "vdd.h"
#include "meas_rates.h"

#define SYS_LOG_DOMAIN "CCS811_BT"
#define SYS_LOG_LEVEL SYS_LOG_LEVEL_INFO
#include <logging/sys_log.h>

#define CCS_VDD_PWR_CTRL_GPIO_PIN 10

static struct device *dev;
static struct device *ccs_vdd_gpio;
static struct vdd_rail_dev rail_dev;
static struct vdd_rail_dev rail_dev_gpio;

void ccs811_bt_update(void)
{
	struct sensor_value co2_val, voc_val;
	int err;
	int retry_count;

	if (!dev)
		return;

	for (retry_count = 0; retry_count < 10; ++retry_count) {
		err = sensor_sample_fetch(dev);
		if (err)
			continue;
		sensor_channel_get(dev, SENSOR_CHAN_CO2, &co2_val);
		if (!co2_val.val1)
			continue;
		break;
	}
	if (retry_count == 10) {
		SYS_LOG_ERR("CCS811 sample fetch failed");
		return;
	}

	sensor_channel_get(dev, SENSOR_CHAN_CO2, &co2_val);
	sensor_channel_get(dev, SENSOR_CHAN_VOC, &voc_val);

	ccs811_bt_co2 = co2_val.val1;
	ccs811_bt_voc = voc_val.val1;

	SYS_LOG_INF("co2: %d, voc: %d", ccs811_bt_co2, ccs811_bt_voc);
}

void ccs811_bt_init(void)
{
	static const struct sensor_value sampling_interval = { .val1 = 10,
							       .val2 = 0 };
	int retry_count;
	int err;

	dev = device_get_binding("CCS811");
	if (!dev) {
		SYS_LOG_ERR("Failed to get CCS811 device binding");
		return;
	}

	vdd_rail_dev_call_init(&rail_dev, dev);

	for (retry_count = 10; retry_count; --retry_count) {
		err = sensor_sample_fetch(dev);
		if (err) {
			continue;
		}
		break;
	}
	if (retry_count == 0)
		SYS_LOG_ERR("CCS811 sample fetch failed");

	sensor_attr_set(dev, SENSOR_CHAN_CO2, SENSOR_ATTR_SAMPLING_INTERVAL,
			&sampling_interval);
}

static void ccs811_slow_measurement(void)
{
	vdd_get();

	ccs_vdd_gpio = device_get_binding(CONFIG_GPIO_SX1509B_DEV_NAME);
	if (!ccs_vdd_gpio) {
		SYS_LOG_ERR("Failed to get SX1509B device binding");
		return;
	}
	vdd_rail_dev_call_init(&rail_dev_gpio, ccs_vdd_gpio);
	gpio_pin_configure(ccs_vdd_gpio, CCS_VDD_PWR_CTRL_GPIO_PIN,
			   GPIO_DIR_OUT);
	gpio_pin_write(ccs_vdd_gpio, CCS_VDD_PWR_CTRL_GPIO_PIN, 1);

	ccs811_bt_init();
	k_sleep(meas_intervals->ccs811);
	ccs811_bt_update();
	gpio_pin_write(ccs_vdd_gpio, CCS_VDD_PWR_CTRL_GPIO_PIN, 0);

	vdd_put();
}

static void ccs811_fast_measurement(void)
{
	/* There's no matching put because the rail has to be always on */
	vdd_get();

	if (!dev)
		ccs811_bt_init();
	k_sleep(meas_intervals->ccs811);
	ccs811_bt_update();
}

static void ccs811_bt_thread(void *p1, void *p2, void *p3)
{
	vdd_rail_dev_register(&rail_dev);
	vdd_rail_dev_register(&rail_dev_gpio);

	for (;;) {
		/* 30 min is the tie point */
		if (meas_intervals->ccs811 > 1800000) {
			ccs811_slow_measurement();
		} else {
			ccs811_fast_measurement();
		}
	}
}

K_THREAD_DEFINE(ccs811_bt_thd, 512, ccs811_bt_thread, NULL, NULL, NULL,
		10, 0, K_NO_WAIT);
```

## src/ccs811_bt.h
```c
#ifndef CCS811_BT_H
#define CCS811_BT_H

#define UUID_PRIMARY	BT_UUID_DECLARE_16(0x0200)
#define UUID_CO2	BT_UUID_DECLARE_16(0x0201)
#define UUID_VOC	BT_UUID_DECLARE_16(0x0202)

#define CCS811_BT_MEAS_INTERVAL 10000

void ccs811_bt_update(void);
void ccs811_bt_init(void);
u16_t ccs811_bt_co2; /* In ppm */
u16_t ccs811_bt_voc; /* In ppb */

#endif
```

## src/hts221_bt.c
```c
#include <nrf.h>
#include <sensor.h>
#include <stdio.h>

#include "hts221_bt.h"
#include "vdd.h"
#include "meas_rates.h"

#define SYS_LOG_DOMAIN "HTS221_BT"
#define SYS_LOG_LEVEL SYS_LOG_LEVEL_INFO
#include <logging/sys_log.h>

static struct device *dev;

void hts221_bt_init(void)
{

	dev = device_get_binding("HTS221");
	if (!dev) {
		SYS_LOG_ERR("Failed to get HTS221 device binding\n");
		return;
	}

	/* There's no need to rerun the device init on HTS221 */
}

void hts221_bt_update(void)
{
	struct sensor_value h, t;
	int err;

	if (!dev)
		return;

	err = sensor_sample_fetch(dev);
	if (err) {
		SYS_LOG_ERR("HTS221 sample fetch failed\n");
		return;
	}

	err = sensor_channel_get(dev, SENSOR_CHAN_AMBIENT_TEMP, &t);
	if (err)
		SYS_LOG_ERR("temp channel get failed");
	err = sensor_channel_get(dev, SENSOR_CHAN_HUMIDITY, &h);
	if (err)
		SYS_LOG_ERR("humid channel get failed");

	hts221_bt_temp = sensor_value_to_double(&t) * 100;
	hts221_bt_humid = sensor_value_to_double(&h) * 100;
	SYS_LOG_INF("temp: %d, humid: %d", t.val1, h.val1);
}

static void hts221_bt_thread(void *p1, void *p2, void *p3)
{
	for (;;) {
		vdd_get();
		hts221_bt_init();
		hts221_bt_update();
		vdd_put();
		k_sleep(meas_intervals->hts221);
	}
}

K_THREAD_DEFINE(hts221_bt_thd, 512, hts221_bt_thread, NULL, NULL, NULL,
		10, 0, K_NO_WAIT);
```

## src/hts221_bt.h
```c
#ifndef HTS221_BT_H
#define HTS221_BT_H

#include <sys/types.h>

#define HTS221_BT_MEAS_INTERVAL 5000

void hts221_bt_update(void);
void hts221_bt_init(void);
s16_t hts221_bt_temp;
u16_t hts221_bt_humid;

#endif
```

## src/meas_rates.c
```c
#include "meas_rates.h"

#if 0
/* Debug */
const struct meas_intervals fast_meas_intervals = {
	.ccs811		= 10000,
	.hts221		= 5000,
	.tcs34725	= 5000,
};
#else
const struct meas_intervals fast_meas_intervals = {
	.ccs811		= 600000,
	.hts221		= 600000,
	.tcs34725	= 600000,
};
#endif

const struct meas_intervals slow_meas_intervals = {
	.ccs811		= 10800000,
	.hts221		= 3600000,
	.tcs34725	= 3600000,
};

const struct meas_intervals *meas_intervals = &fast_meas_intervals;
```

## src/meas_rates.h
```c
#ifndef MEAS_RATES_H
#define MEAS_RATES_H

#include <kernel.h>

struct meas_intervals {
	s32_t ccs811;
	s32_t hts221;
	s32_t tcs34725;
};

const struct meas_intervals fast_meas_intervals;
const struct meas_intervals slow_meas_intervals;
const struct meas_intervals *meas_intervals;

#endif
```

## src/on_chip_temp.c
```c
#include <bluetooth/gatt.h>
#include <nrf.h>
#include <stdio.h>

#include "on_chip_temp.h"

#define SYS_LOG_DOMAIN "on_chip_temp"
#define SYS_LOG_LEVEL SYS_LOG_LEVEL_INFO
#include <logging/sys_log.h>

s16_t on_chip_temp_get(void)
{
	NRF_TEMP->TASKS_START = 1;
	while (!NRF_TEMP->EVENTS_DATARDY)
		;
	return NRF_TEMP->TEMP * 25;
}

void on_chip_temp_update(void)
{
	on_chip_temp = on_chip_temp_get();
}

static void on_chip_temp_thread(void *p1, void *p2, void *p3)
{
	for (;;) {
		on_chip_temp_update();
		k_sleep(ON_CHIP_TEMP_MEAS_INTERVAL);
	}
}

K_THREAD_DEFINE(on_chip_temp_thd, 512, on_chip_temp_thread, NULL, NULL, NULL,
		10, 0, K_NO_WAIT);
```

## src/on_chip_temp.h
```c
#ifndef ON_CHIP_TEMP_H
#define ON_CHIP_TEMP_H

#include <sys/types.h>

#define ON_CHIP_TEMP_MEAS_INTERVAL 1000

/* Temperature in Centicelsius */
s16_t on_chip_temp_get(void);
void on_chip_temp_update(void);

s16_t on_chip_temp;

#endif
```
